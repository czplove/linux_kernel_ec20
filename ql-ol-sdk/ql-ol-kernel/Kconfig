## ql-ol-sdk/ql-ol-kernel/Kconfig
```kconfig
#
# For a description of the syntax of this configuration file,
# see Documentation/kbuild/kconfig-language.txt.
#
mainmenu "Linux/$ARCH $KERNELVERSION Kernel Configuration"

config SRCARCH
	string
	option env="SRCARCH"

source "arch/$SRCARCH/Kconfig"

#2015-12-05, add by jun.wu, for quectel global configs
source "qconfig/Kconfig"
```

## ql-ol-sdk/ql-ol-kernel/drivers/quectel-drivers/Kconfig
```kconfig
#
# Optional quectel drivers configuration
#

menu "Quectel optional drivers"

config QUECTEL_DRIVER
	bool "quectel drivers"
	default y
	---help---
	  Quectel Drivers.

if QUECTEL_DRIVER

config LOW_POWER_CONSUME
	bool "low power consume driver"
	default n
	---help---
	  Low power consume driver, refer to KBA document.

config QTZONE
	bool "quectel trust zone support"
	default n
	---help---
	  Trust zone function, consult quectel engineer further.

config QSTART
	bool "QSTART"
	default y
	---help---
	  legacy

config QSMD
	bool "QSMD"
	default n
	---help---
	  legacy

config QSMEM
	bool "QSMEM"
	default n
	---help---
	  legacy

endif

endmenu
```

## ql-ol-sdk/ql-ol-kernel/qconfig/Kconfig
```kconfig
#
# Add Quectel global configurations here.
#
# Add by scott.hu at 2014-10-23.
#
menu "Quectel global configurations"

# 2014-10-23 add by scott.hu
config QUECTEL_AUDIO_DRIVER
    bool "quectel audio driver"
    default y

config QUECTEL_POWER_DRIVER
    bool "quectel power driver"
    default y

config QUECTEL_MODEM_RESTART_LEVEL
    bool "quectel modem restart level"
    default y 

config QUECTEL_MODEM_BOOT_TIME
    bool "quectel modem boot time"
    default y

config QUECTEL_PCM16K_SUPPORT
    bool "quectel pcm 16k"
    default y

# end jun.wu
endmenu
```
